## kernel/arch/unicore/mach-sep0611/Kconfig
```kconfig
config MACH_SEP0611
	bool
	default y

choice
	prompt "Select The Target Board"
	depends on ARCH_SEP0611
	default TIGER_DEMO_BOARD

config TIGER_TEST_BOARD
	bool "Tiger Test Board"
	help
	  Say Y or N if you want to add support tiger test board	  

config TIGER_DEMO_BOARD
	bool "Tiger Demo Board"
	help
	  Say Y or N if you want to add support tiger demo board

config TIGER_SPDW_BOARD
	bool "Tiger Spreadwin Board"
	help
	  Say Y or N if you want to add support tiger spreadwin board

config TIGER_TOY_BOARD
	bool "Tiger Wificar Toy Board"
	help
	  Say Y or N if you want to add support tiger wificar toy board

config TIGER_PCARE_BOARD
	bool "Tiger Wificar Pcare Board"
	help
	  Say Y or N if you want to add support tiger wificar toy board

endchoice

config SEP_CLK_800
   bool "SEP clock use 804/201/402MHz"
   depends on CPU_FREQ_DEFAULT_GOV_PERFORMANCE 
   help
     Support board, Say Y here if you
     want to use 804/201/402Mhz (you have to change the core voltage and use DDR2 RAM)

config SEP_CLK_600
   bool "SEP clock use 600/201/402MHz"
   depends on CPU_FREQ_DEFAULT_GOV_PERFORMANCE && !SEP_CLK_800 
   help
     Support board, Say Y here if you
     want to use 600/201/402Mhz (you have to change the core voltage and use DDR2 RAM)

config SEP_CLK_500
   bool "SEP clock use 504/201/402MHz"
   depends on CPU_FREQ_DEFAULT_GOV_PERFORMANCE && !SEP_CLK_800  && !SEP_CLK_600
   help
     Support board, Say Y here if you
     want to use 504/201/402Mhz (you have to change the core voltage and use DDR2 RAM)
```

## kernel/drivers/char/gpio/Kconfig
```kconfig
menu "sep0611 GPIO char support"

config SEP0611_GPIO
	tristate "sep0611 general gpio driver"

endmenu
```

## kernel/drivers/char/hdmi/Kconfig
```kconfig
#Add by lixiang 20110531 13:55
config SEP_HDMI
        tristate "Cat6613 hdmi driver"
        default y
```

## kernel/drivers/gps/Kconfig
```kconfig
#
# TPM device configuration
#

menuconfig SEP_GPS
	tristate "SEP GPS Support"
	default y
```

## kernel/drivers/i2c/chips/Kconfig
```kconfig
#
# Miscellaneous I2C chip drivers configuration
#
# *** DEPRECATED! Do not add new entries! See Makefile ***
#

menu "Miscellaneous I2C Chip support"

config DS1682
	tristate "Dallas DS1682 Total Elapsed Time Recorder with Alarm"
	depends on EXPERIMENTAL
	help
	  If you say yes here you get support for Dallas Semiconductor
	  DS1682 Total Elapsed Time Recorder.

	  This driver can also be built as a module.  If so, the module
	  will be called ds1682.

config SENSORS_TSL2550
	tristate "Taos TSL2550 ambient light sensor"
	depends on EXPERIMENTAL
	help
	  If you say yes here you get support for the Taos TSL2550
	  ambient light sensor.

	  This driver can also be built as a module.  If so, the module
	  will be called tsl2550.

config SENSORS_PCA963X
	tristate "Philips PCA963X 4-bit I2C-bus LED"
	depends on I2C && EXPERIMENTAL
	help
	 If you say yes here you get support for the Philips PCA963X
	 4-bit I2C-bus LED.

	 This driver can also be built as a module.  If so, the module
	 will be called pca963X.
	 
config GSENSOR_MMA7660
	tristate "mma7660 I2C-bus g-sensor"
	depends on I2C && EXPERIMENTAL
	help
	 If you say yes here you get support for the mma7660 I2C-bus 
	 g-sensor.

	 This driver can also be built as a module.  If so, the module
	 will be called mma7660.
	 
config GSENSOR_MMA7660_USE_INTERRUPT
	tristate "mma7660 I2C-bus g-sensor driver with hardware interrupt support"
	depends on GSENSOR_MMA7660
choice
prompt "choice gsensor's location"
config GSENSOR_MMA7660_TOP
	bool "mma7660 chip is on the top of the board"
	depends on GSENSOR_MMA7660
	help
         this tell us the chip is on the top of the board .

config GSENSOR_MMA7660_BOTTOM
	bool "mma7660 chip is on the bottom of the board"
	depends on GSENSOR_MMA7660
	help
	 this tell us the chip is on the bottom of the board.
endchoice	
endmenu
```

## kernel/drivers/staging/iio/adc/Kconfig
```kconfig
#
# ADC drivers
#
comment "Analog to digital convertors"

config MAX1363
	tristate "MAXIM max1363 ADC driver"
	depends on I2C
	help
	  Say yes here to build support for many MAXIM i2c analog to digital
	  convertors (ADC). (max1361, max1362, max1363, max1364, max1136,
	  max1136, max1137, max1138, max1139, max1236, max1237, max11238,
	  max1239) Provides direct access via sysfs.
	  
config AD799X
	tristate "Analog Devices AD799x ADC driver"
	depends on I2C
	select IIO_TRIGGER if IIO_RING_BUFFER
	select AD799X_RING_BUFFER
	help
	  Say yes here to build support for Analog Devices:
	  ad7991, ad7995, ad7999, ad7992, ad7993, ad7994, ad7997, ad7998
	  i2c analog to digital convertors (ADC). Provides direct access
	  via sysfs.

config AD799X_RING_BUFFER
	bool "Analog Devices AD799x: use ring buffer"
	depends on AD799X
	select IIO_RING_BUFFER
	select IIO_SW_RING
	help
	  Say yes here to include ring buffer support in the AD799X
	  ADC driver.
```
